## config/boards/shields/split_keyboard/Kconfig.defconfig
```kconfig
if SHIELD_SPLIT_KEYBOARD_LEFT || SHIELD_SPLIT_KEYBOARD_RIGHT

config ZMK_KEYBOARD_NAME
    default "Split Keyboard"

config ZMK_SPLIT
    default y

endif

if SHIELD_SPLIT_KEYBOARD_LEFT

config ZMK_SPLIT_ROLE_CENTRAL
    default y

endif
```
