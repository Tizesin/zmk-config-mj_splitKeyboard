## config/boards/shields/split_keyboard/Kconfig.shield
```kconfig
config SHIELD_SPLIT_KEYBOARD_LEFT
    def_bool $(shields_list_contains,split_keyboard_left)

config SHIELD_SPLIT_KEYBOARD_RIGHT
    def_bool $(shields_list_contains,split_keyboard_right)
```
